## build/Kconfig/Kconfig.shield.defconfig
```kconfig
osource "c:/Users/zac46/Documents/Nordic/motor_control_test/boards/shields/*/Kconfig.defconfig"
osource "c:/Users/zac46/Documents/Nordic/bluetooth_peripheral_uart/boards/shields/*/Kconfig.defconfig"
osource "c:/Users/zac46/Documents/Nordic/mpu6050_sample/boards/shields/*/Kconfig.defconfig"
osource "C:/ncs/v2.1.2/nrf/boards/shields/*/Kconfig.defconfig"
```

## build_1/Kconfig/Kconfig.shield
```kconfig
osource "c:/Users/zac46/Documents/Nordic/motor_control_test/boards/shields/*/Kconfig.shield"
osource "c:/Users/zac46/Documents/Nordic/bluetooth_peripheral_uart/boards/shields/*/Kconfig.shield"
osource "c:/Users/zac46/Documents/Nordic/mpu6050_sample/boards/shields/*/Kconfig.shield"
osource "C:/ncs/v2.2.0/nrf/boards/shields/*/Kconfig.shield"
```
